## fpga/esp32S3/Guitar_Controller_R15/main/Kconfig.projbuild
```kconfig
menu "Guitar Hall pick inputs"
config HALL_ADC_ENABLE
    bool "Enable analog Hall input samples"
    default y
    help
        Confirm every connected output is ADC-safe and has a common ground.
        Never connect a 5V output directly. H1/H2 use GPIO1/2; H3..H7 use GPIO14..18.
        H1 strums strings 6..1 using one touch snapshot, spaced by at least 8ms.
        H2..H7 individually trigger strings 6..1.
        Sampling starts disarmed; HALL,ARM,ON recalibrates before triggering.
config HALL_ACTIVE_MASK
    hex "Connected Hall channels (bit 0=H1, bit 6=H7)"
    range 0x00 0x7f
    default 0x3f
config HALL_REVERSE_ORDER
    bool "Reverse H2..H7 to strings 1..6 (H1 always strums 6..1)"
    default n
config HALL_TRIGGER_RAW
    int "Minimum displacement to trigger (12-bit ADC raw counts)"
    range 8 1000
    default 32
config HALL_FULL_SCALE_RAW
    int "Displacement corresponding to maximum velocity"
    range 64 3000
    default 700
endmenu
```

## fpga/esp32S3/Guitar_Controller_R15/sdkconfig.defaults
```kconfig
CONFIG_IDF_TARGET="esp32s3"
CONFIG_ESPTOOLPY_FLASHSIZE_16MB=y
CONFIG_ESPTOOLPY_FLASHMODE_DIO=y
CONFIG_ESPTOOLPY_FLASHFREQ_80M=y
CONFIG_SPIRAM=y
CONFIG_SPIRAM_MODE_OCT=y
CONFIG_SPIRAM_SPEED_80M=y
CONFIG_ESP_CONSOLE_UART_DEFAULT=y
CONFIG_ESP_CONSOLE_SECONDARY_USB_SERIAL_JTAG=y
CONFIG_ESP_CONSOLE_UART_BAUDRATE=115200
CONFIG_FREERTOS_HZ=1000
CONFIG_HALL_ADC_ENABLE=y
CONFIG_HALL_ACTIVE_MASK=0x3f
# CONFIG_ESP_WIFI_ENABLED is not set
CONFIG_BT_ENABLED=y
CONFIG_BT_BLUEDROID_ENABLED=y
CONFIG_BT_CONTROLLER_ENABLED=y
CONFIG_BT_BLE_ENABLED=y
# CONFIG_BT_NIMBLE_ENABLED is not set

# CONFIG_BT_BLE_50_FEATURES_SUPPORTED is not set

CONFIG_BT_BLE_42_FEATURES_SUPPORTED=y

# CONFIG_BT_GATTC_ENABLE is not set

# CONFIG_BT_BLE_42_SCAN_EN is not set

# CONFIG_BT_BLE_42_DTM_TEST_EN is not set
```
